// SPDX-License-Identifier: (GPL-2.0+ OR BSD-3-Clause)
/*
 * Copyright (C) 2026 PHYTEC Messtechnik GmbH
 * Authors: Christophe Parant <c.parant@phytec.fr>
 *          Nicolas Raimundo <n.raimundo@phytec.fr>
 */

&tfa_bl31 {
	st,protreg = <RISABPROT(RIF_DDCID_EN, RIF_CID1, RIF_SEC, RIF_NPRIV, RIF_CFEN, RIF_CID1_BF, RIF_CID1_BF, RIF_CID1_BF)>;
};

&hpdma_lli {
	st,protreg = <RISABPROT(RIF_DDCID_EN, RIF_CID1, RIF_NSEC, RIF_NPRIV, RIF_CFEN, RIF_CID1_BF, RIF_CID1_BF, RIF_CID1_BF)>;
};

&risab1 {
	memory-region = <&tfa_bl31>;
};

&risab2 {
	memory-region = <&hpdma_lli>;
};
