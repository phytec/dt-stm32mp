// SPDX-License-Identifier: (GPL-2.0+ OR BSD-3-Clause)
/*
 * Copyright (C) 2026 PHYTEC Messtechnik GmbH
 * Authors: Christophe Parant <c.parant@phytec.fr>
 *          Nicolas Raimundo <n.raimundo@phytec.fr>
 */

/dts-v1/;

#include "stm32mp257f-phyflex-fpsc-g-som-m33td.dts"

/ {

};
