// SPDX-License-Identifier: (GPL-2.0+ OR BSD-3-Clause)
/*
 * Copyright (C) 2026 PHYTEC Messtechnik GmbH
 * Authors: Christophe Parant <c.parant@phytec.fr>
 *          Nicolas Raimundo <n.raimundo@phytec.fr>
 */

/ {
	dtb-registry {
		soc_fw-config {
			load-address = <0x0 0x81fc0000>;
			max-size = <0x40000>;
		};
		tos_fw {
			load-address = <0x0 0x82000000>;
			max-size = <0x2000000>;
		};
	};
};
